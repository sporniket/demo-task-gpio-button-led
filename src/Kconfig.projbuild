## src/Kconfig.projbuild
```kconfig
# Copyright 2021,2022,2023 David SPORN
# ---
# This file is part of 'Kimchi on the beach'.
# ---
# 'Kimchi on the beach' is free software: you can redistribute it and/or 
# modify it under the terms of the GNU General Public License as published 
# by the Free Software Foundation, either version 3 of the License, or 
# (at your option) any later version.

# 'Kimchi on the beach' is distributed in the hope that it will be useful, 
# but WITHOUT ANY WARRANTY; without even the implied warranty of 
# MERCHANTABILITY or FITNESS FOR A PARTICULAR PURPOSE. See the GNU General 
# Public License for more details.

# You should have received a copy of the GNU General Public License along 
# with 'Kimchi on the beach'. If not, see <https://www.gnu.org/licenses/>. 

menu "TASK, GPIO, ANIMATED LED DEMO"

    config PIN_STATUS_MAIN
        int "Main LED GPIO number"
        range 0 34
        default 15
        help
            GPIO number (IOxx) for the 'Main status' LED.

    config PIN_BUTTON_ACTION_WHITE
        int "BUTTON 'ACTION' [WHITE] GPIO number"
        range 0 34
        default 18
        help
            GPIO number (IOxx) for the button panel : 'action'/'fire'/'ok', white button.

endmenu
```
